## meta-piosk/conf/layer.conf
```bitbake
# We have a conf and classes directory, append to BBPATH
BBPATH .= ":${LAYERDIR}"

# We have a recipes directory containing .bb and .bbappend files, add to BBFILES
BBFILES += "${LAYERDIR}/recipes*/*/*.bb \
            ${LAYERDIR}/recipes*/*/*.bbappend"

BBFILE_COLLECTIONS += "piosk"
BBFILE_PATTERN_piosk := "^${LAYERDIR}/"
BBFILE_PRIORITY_piosk = "10"

LAYERSERIES_COMPAT_piosk = "nanbield"
LAYERDEPENDS_piosk = "raspberrypi chromium-browser-layer"
```

## meta-piosk/wic/sdimage-tinyqpi.wks
```
# short-description: Create TinyQPi SD card image with swap
# long-description: Creates a partitioned SD card image for use with
# Raspberry Pi. Boot files are located in the first vfat partition.
# With Swap partition

part /boot --source bootimg-partition --ondisk mmcblk0 --fstype=vfat --label boot --active --align 4096 --size 20
part / --source rootfs --ondisk mmcblk0 --fstype=ext4 --label root --align 4096
part swap --ondisk mmcblk0 --size 3000M --label swap --fstype=swap
```
